## sw/scripts/lpddr/synopsys/sim/sw_utilities/cinit/library/configs/testbench_defconfig
```kconfig
# Demo defconfig file for LPDDR5
# This defconfig may not pass for every HW parameter combination and may need modifications.
# General configurations
CONFIG_SNPS_DEFCONFIG="LPDDR5_DEMO_6400_4G_x16_4BK4BG_1_4_defconfig"

CONFIG_NUM_PSTATES=@UMCTL2_FREQUENCY_NUM
CONFIG_DWC_DDRCTL_CINIT_REGB_FREQ[0:@UMCTL2_FREQUENCY_NUM-1]_CH0_DRAMSET1TMG14_T_XSR=800
DDRCTL_PSTATE[0:@UMCTL2_FREQUENCY_NUM-1]_FREQUENCY_RATIO_4_1=y
CONFIG_DWC_DDRCTL_CINIT_LPDDR5_PSTATE[0:@UMCTL2_FREQUENCY_NUM-1]_MR1_CK_MODE=0
CONFIG_DWC_DDRCTL_CINIT_LPDDR5_PSTATE[0:@UMCTL2_FREQUENCY_NUM-1]_MR3_PDDS=6
CONFIG_DWC_DDRCTL_CINIT_LPDDR5_PSTATE[0:@UMCTL2_FREQUENCY_NUM-1]_MR10_RDQS_PST=1
CONFIG_DWC_DDRCTL_CINIT_LPDDR5_PSTATE[0:@UMCTL2_FREQUENCY_NUM-1]_MR10_RDQS_PRE=1
CONFIG_DWC_DDRCTL_CINIT_LPDDR5_PSTATE[0:@UMCTL2_FREQUENCY_NUM-1]_MR10_WCK_PST=2
CONFIG_DWC_DDRCTL_CINIT_LPDDR5_PSTATE[0:@UMCTL2_FREQUENCY_NUM-1]_MR17_ODTD_CA=1
CONFIG_DWC_DDRCTL_CINIT_LPDDR5_PSTATE[0:@UMCTL2_FREQUENCY_NUM-1]_MR17_ODTD_CK=1
CONFIG_DWC_DDRCTL_CINIT_LPDDR5_PSTATE[0:@UMCTL2_FREQUENCY_NUM-1]_MR20_RDQS=2
CONFIG_DWC_DDRCTL_CINIT_LPDDR5_PSTATE[0:@UMCTL2_FREQUENCY_NUM-1]_MR11_CA_ODT=1
CONFIG_DWC_DDRCTL_CINIT_LPDDR5_PSTATE[0:@UMCTL2_FREQUENCY_NUM-1]_MR11_DQ_ODT=1
CONFIG_DWC_DDRCTL_CINIT_LPDDR5_PSTATE[0:@UMCTL2_FREQUENCY_NUM-1]_MR12_VREF_CA=0

# DDRC channel #0
CONFIG_DWC_DDRCTL_CINIT_REGB_DDRC_CH0_CHCTL_DUAL_CHANNEL_EN_AUX=n
CONFIG_DWC_DDRCTL_CINIT_REGB_DDRC_CH0_DFIMISC_DFI_DATA_CS_POLARITY_AUX=y


CONFIG_DWC_DDRCTL_CINIT_REGB_DDRC_CH0_DFIMISC_DFI_CHANNEL_MODE=1


CONFIG_DWC_DDRCTL_CINIT_REGB_DDRC_CH0_DFIPHYMSTR_DFI_PHYMSTR_EN_AUX=n
CONFIG_DWC_DDRCTL_CINIT_REGB_DDRC_CH0_ECCCFG0_ECC_MODE=0
CONFIG_DWC_DDRCTL_CINIT_REGB_DDRC_CH0_ECCCFG0_ECC_AP_EN_AUX=y
CONFIG_DWC_DDRCTL_CINIT_REGB_DDRC_CH0_ECCCFG0_ECC_REGION_MAP=127
CONFIG_DWC_DDRCTL_CINIT_REGB_DDRC_CH0_DFIPHYMSTR_DFI_PHYMSTR_EN_AUX=n
CONFIG_DWC_DDRCTL_CINIT_REGB_DDRC_CH0_DFIUPD0_DFI_PHYUPD_EN_AUX=n
CONFIG_DWC_DDRCTL_CINIT_REGB_DDRC_CH0_DFIUPD0_DIS_AUTO_CTRLUPD_SRX_AUX=y
CONFIG_DWC_DDRCTL_CINIT_REGB_DDRC_CH0_DFIUPD0_DIS_AUTO_CTRLUPD_AUX=y
CONFIG_DWC_DDRCTL_CINIT_REGB_DDRC_CH0_PWRCTL_SELFREF_EN=1
CONFIG_DWC_DDRCTL_CINIT_REGB_DDRC_CH0_PWRCTL_POWERDOWN_EN=1
# CONFIG_DWC_DDRCTL_CINIT_REGB_FREQ1_CH0_DQSOSCCTL0_DQSOSC_ENABLE_AUX=y



CONFIG_DWC_DDRCTL_CINIT_REGB_DDRC_CH0_MSTR0_ACTIVE_RANKS=3

#
# Initialization Speedups
CONFIG_DWC_DDRCTL_CINIT_REGB_DDRC_CH0_INITTMG0_PRE_CKE_X1024=2
CONFIG_DWC_DDRCTL_CINIT_REGB_DDRC_CH0_INITTMG0_POST_CKE_X1024=2

CONFIG_DWC_DDRCTL_CINIT_REGB_DDRC_CH0_INITTMG0_SKIP_DRAM_INIT=1

CONFIG_DWC_DDRCTL_CINIT_REGB_DDRC_CH0_MSTR4_WCK_ON_AUX=y

# Memory Configuration
CONFIG_DWC_DDRCTL_CINIT_SDRAM_PROTOCOL_LPDDR5=y
CONFIG_DWC_DDRCTL_CINIT_SPD_STATIC_SPEED_GRADE=y
CONFIG_DWC_DDRCTL_CINIT_LPDDR5_DATA_RATE_6400=y
CONFIG_DWC_DDRCTL_CINIT_CUSTOM_TCK=y
CONFIG_DWC_DDRCTL_CINIT_TCK_PS_0=1250
CONFIG_DWC_DDRCTL_CINIT_LPDDR5_PSTATE0_BK_BG_4BK_4BG=y

CONFIG_DWC_DDRCTL_CINIT_SDRAM_CAPACITY_MBIT_0_4_GB=y
CONFIG_DWC_DDRCTL_CINIT_SDRAM_WIDTH_BITS_0_16_BITS=y
CONFIG_DWC_DDRCTL_CINIT_SDRAM_BUS_WIDTH_FULL=y


CONFIG_DWC_DDRCTL_CINIT_NUM_RANKS_2_RANK=y

#

CONFIG_CONFIG_DWC_LPDDR5X4_TYPE_PHY=y

# Skip PHY training
CONFIG_CONFIG_DWC_SKIP_TRAINING=y
```
